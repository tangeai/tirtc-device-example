## complete-applications/esp32-p4/device-monitor/main/Kconfig.projbuild
```kconfig
menu "Audio"

config AUDIO_LOCAL_LOOPBACK_TEST
    bool "Enable temporary local mic-to-speaker loopback test"
    default n

config APP_AUDIO_AEC_ENABLE
    bool "Enable ESP-SR acoustic echo cancellation"
    default y
    help
        Preloads the ESP-SR AEC engine when a full-duplex audio owner prepares
        its media path. Runtime processing is enabled for IPC viewing, device
        calls, WeChat VoIP, and AI Chat, and is disabled outside those media
        sessions. Each application keeps its existing audio ownership model.

config APP_AUDIO_AEC_REF_DELAY_MS
    int "Software AEC reference fallback delay (ms)"
    depends on APP_AUDIO_AEC_ENABLE
    range 40 160
    default 80
    help
        ES8311 boards first use the codec-synchronous DAC reference channel,
        which needs no guessed delay. This value is used only if that hardware
        reference cannot be detected. Adjust the fallback from synchronized
        full-duplex recordings; an incorrect value weakens cancellation.

endmenu

menu "AI Chat"

config APP_AI_CHAT_VIDEO_ENABLE
    bool "Upload local H264 camera video during AI Chat"
    default y
    help
        Start the existing ESP32-P4 camera and hardware H264 uplink only after
        start_session succeeds. AI Chat video uses stream 0 while PCM audio
        remains on stream 1. If camera startup fails, the audio conversation
        continues without video.

endmenu

menu "WeChat VoIP"

config APP_WECHAT_VOIP_LOCAL_VIDEO_ENABLE
    bool "Upload local camera video during WeChat calls"
    default y
    help
        Advertise WeChat calls as video capable and proactively publish the
        ESP32-P4 camera through the existing YUV420-to-H264 RTC pipeline after
        the WeChat room is joined. The WeChat audio path remains externally
        owned by the dedicated PCMA capture task.

config APP_WECHAT_VOIP_REMOTE_VIDEO_ENABLE
    bool "Display remote WeChat video during calls"
    default y
    help
        Request the standard 640x480 landscape MJPEG downlink, decode the
        received frames with the ESP32-P4 hardware JPEG decoder, and map them
        once to the physical 480x320 display without non-uniform stretching or
        local rotation. Smaller adaptive frames may be uniformly enlarged to
        fill the display. The local camera uplink remains H264. Disable only
        for an audio-only product variant.

endmenu

menu "RTC video uplink"

config APP_RTC_H264_DIRECT_HW_ENCODER
    bool "Use direct ESP_H264 hardware encoder for RTC video"
    default y
    help
        Bypass the V4L2 memory-to-memory H264 wrapper on the RTC camera
        uplink hot path and call the ESP32-P4 hardware encoder directly.
        The direct path keeps the native 1280x960 encoder output in PSRAM and leaves
        enough internal DMA memory for ESP-Hosted SDIO during full-duplex
        audio/video calls.

config APP_RTC_H264_RESOURCE_FALLBACK_ENABLE
    bool "Allow H264 resource-admission resolution fallback"
    default y
    help
        If the requested hardware encoder cannot reserve one contiguous
        internal reference-frame block, first use the compact camera/encoder
        pair that keeps the P4 YUV420 path direct. Only fall back to another
        aligned size when that compact profile cannot fit. This is a local
        resource safety net only: it does not enable weak-network adaptation
        or change the saved RTC video policy. A normally prewarmed encoder
        still uses the requested size.

config APP_RTC_H264_BITRATE
    int "RTC H264 target bitrate"
    range 500000 12000000
    default 4000000
    help
        Target bitrate used by the ESP32-P4 hardware H264 encoder for the
        RTC camera uplink. The normal profile is tuned for sustained 1280x960 at 20fps
        with bounded send latency; raise this only after logs prove the
        transport keeps draining without backpressure.

config APP_RTC_H264_FPS
    int "RTC H264 target FPS"
    range 5 30
    default 20
    help
        Normal RTC camera uplink frame rate. Keep this separate from the
        camera sensor mode: the OV5647 uses its 1280x960 binning mode, while
        the current TiRTC application sends the native YUV420 frame at 20fps with bounded send
        latency. Weak-network adaptation remains disabled unless explicitly
        enabled below.

config APP_DEVICE_CALL_VIDEO_WIDTH
    int "Device-call H264 width"
    range 320 1280
    default 480
    help
        Video profile used only for bidirectional device calls. The default
        matches the 480x320 landscape display and asks the ISP for the same
        native YUV420 output, avoiding an application-side resize. IPC viewing
        keeps the normal RTC profile above.

config APP_DEVICE_CALL_VIDEO_HEIGHT
    int "Device-call H264 height"
    range 240 960
    default 320

config APP_DEVICE_CALL_VIDEO_FPS
    int "Device-call H264 FPS"
    range 5 30
    default 15
    help
        The full-duplex call path defaults to a stable 15fps. This is the
        minimum acceptance target under simultaneous encode, software decode,
        audio, UI and Wi-Fi load; higher profiles can be selected only after
        runtime statistics prove enough headroom.

config APP_DEVICE_CALL_VIDEO_BITRATE
    int "Device-call H264 target bitrate"
    range 300000 6000000
    default 800000
    help
        Normal starting target for the 480x320 bidirectional call profile.
        800 kbps preserves motion detail while leaving enough range for
        transport adaptation. TiRTC feedback may reduce this target
        immediately under congestion, while recovery is deliberately stepped
        after a stable hold. The previous RTC setting is restored when the call
        ends.

config APP_DEVICE_CALL_VIDEO_MIN_QP
    int "Device-call H264 minimum QP"
    range 10 51
    default 22
    help
        Quality floor used only for the 480x320 bidirectional call profile.
        This is intentionally lower than the high-resolution IPC floor so a
        call can use its bitrate budget without changing IPC behavior.

config APP_DEVICE_CALL_VIDEO_MAX_QP
    int "Device-call H264 maximum QP"
    range 10 51
    default 40
    help
        Quality ceiling used only for the bidirectional call profile. QP 40
        limits coarse motion blocks on the 320-pixel display while still
        leaving enough rate-control range for the weak-network levels. Keep it
        greater than or equal to APP_DEVICE_CALL_VIDEO_MIN_QP.

config APP_CALL_VIDEO_DIRECT_LCD
    bool "Use latest-frame direct LCD DMA after call controls auto-hide"
    depends on SOC_PSRAM_DMA_CAPABLE && SPIRAM
    default y
    help
        Keep the interactive controls in LVGL while they are visible, then
        auto-hide them and present each latest RGB565 frame as one full-screen
        PSRAM DMA transaction. Tapping the video restores the controls over the
        retained current frame. This avoids multi-strip temporal tearing during
        motion without sacrificing hangup and volume controls.

config APP_RTC_H264_GOP
    int "RTC H264 GOP"
    range 1 120
    default 30
    help
        GOP used by the ESP32-P4 hardware H264 encoder. Keep this separate
        from FPS: startup and peer recovery still request explicit key frames,
        while a 30-frame GOP gives the 15fps call profile a two-second natural
        recovery point without returning to a visible 0.5s key-frame cadence.

config APP_RTC_H264_MIN_QP
    int "RTC H264 minimum QP"
    range 10 51
    default 34
    help
        Lower bound for encoder QP. Keep this high enough to prevent the
        ESP32-P4 H264 encoder from emitting very large startup delta frames
        that can overflow the proxy/browser path. This is not weak-network
        adaptation; the target bitrate remains configured separately.

config APP_RTC_H264_MAX_QP
    int "RTC H264 maximum QP"
    range 10 51
    default 45

config APP_RTC_H264_OUTPUT_BUFFER_BYTES
    int "RTC H264 output buffer bytes"
    range 524288 4194304
    default 1048576
    help
        MMAP output buffer size for one encoded H264 frame. Keep enough room
        for 1280x960 key frames and high-motion bursts. This buffer does not
        control adaptive downshift; it only protects the encoder output path.

config APP_RTC_H264_MAX_DELTA_PAYLOAD_BYTES
    int "RTC H264 maximum delta frame payload bytes"
    range 65536 1048576
    default 262144
    help
        Hard guard for abnormal non-key frame payloads. Normal operation must
        not drop H264 P frames after encoding, because that breaks the
        reference chain and can make the browser/proxy show a short recovery
        hiccup. Keep the steady-state guard high enough for normal 1280x960 motion
        detail, while the startup guard below remains tighter during decoder
        warmup. GOP should remain short so recovery follows quickly.

config APP_RTC_H264_STARTUP_GUARD_MS
    int "RTC H264 startup transport guard window in milliseconds"
    range 0 10000
    default 2500
    help
        Startup-only window that uses a tighter delta-frame burst limit while
        the browser/proxy decoder and data channels are still warming up. This
        is not weak-network adaptation; after the window expires the normal
        max-delta policy above applies.

config APP_RTC_H264_STARTUP_MAX_DELTA_PAYLOAD_BYTES
    int "RTC H264 startup maximum delta frame payload bytes"
    range 65536 1048576
    default 131072
    help
        Delta-frame payload limit used only during the startup guard window.
        The default is lower than the steady-state guard to limit startup
        bursts. If a delta frame is rejected, the pipeline requests a fresh
        IDR and waits for it before resuming the H264 chain.

config APP_RTC_VIDEO_AUTO_ADAPT_ENABLE
    bool "Enable legacy local RTC video weak-network adaptation"
    default n
    help
        Local fallback driven by queue pressure and send-buffer samples. Keep
        this disabled when TiRTC SDK transport-driven adaptation is available,
        so the application does not change frame rate or resolution before the
        SDK controller publishes its first target.

config APP_RTC_SDK_VIDEO_ADAPT_ENABLE
    bool "Enable TiRTC SDK transport-driven video bitrate adaptation"
    default n
    help
        Optional experimental controller for TiRTC 2.3 or later. Register the
        active encoder bitrate range and
        apply its absolute target-bitrate callback through the application
        control task. The SDK controller owns bitrate after its first feedback.
        The legacy queue-pressure controller is configured independently and is
        disabled by default so it cannot compete with TGMP. Congestion
        reductions apply immediately, quality recovery is stepped after a short
        stable period, resolution and frame rate stay fixed, and the hardware
        encoder is updated in place. Every connection starts from the normal
        configured profile; peers that do not produce TGMP feedback remain on
        that profile, and optional registration failure must not block
        audio/video setup. Keep this disabled in the stable profile until the
        transport controller has passed bidirectional weak-network soak tests.

config APP_RTC_WAIT_VIDEO_SUBSCRIBE_BEFORE_CAPTURE
    bool "Start camera capture after remote video subscription"
    default n
    help
        Disable this for the normal IPC application path so the device starts the
        physical camera/H264 hot path as soon as a call is accepted. That keeps
        the capture/encoder path warm before the WebRTC proxy sends its video
        subscription and shortens first-frame latency.

        Enable it only when saving camera/H264 work before a confirmed remote
        subscription is more important than first-frame time.

config APP_DEVICE_ONLINE_PAUSE_DURING_RTC
    bool "Pause device-online MQTT while RTC media is active"
    default n
    help
        Keep this disabled for normal operation. The permanent MQTT connection
        carries call_cancel, unbind, callers_update and other business events
        that must remain available while RTC media is active.

        Enable this only for isolated media stress tests where losing realtime
        business notifications during the call is acceptable.

config APP_DMA_ESCROW_BYTES
    int "Application DMA escrow bytes"
    range 0 131072
    default 98304
    help
        Contiguous internal DMA-capable memory held at early boot before
        network, UI and business tasks start. The 96 KiB default covers the
        ESP32-P4 H264 reference allocation required by the normal 1280-wide
        profile. H264 and downlink decoder bootstrap can borrow this block;
        PSRAM payload pools must never fall back into it.

config APP_CAMERA_FRAME_TRACE_INITIAL_COUNT
    int "Camera frame trace initial frame count"
    range 0 64
    default 0
    help
        Number of per-frame camera pipeline trace lines printed after a video
        session starts. Keep this at zero for performance tuning. The compact
        MEDIA health line remains available for routine FPS/bitrate diagnosis;
        enable the detailed periodic diagnostics only for focused profiling.

config APP_CAMERA_FRAME_TRACE_INTERVAL_MS
    int "Camera slow/large frame trace interval in milliseconds"
    range 200 60000
    default 10000
    help
        Minimum interval for slow or large frame trace logs. This prevents
        diagnostic logging from disturbing the 1280x960 H264 hot path while still
        keeping enough evidence when the encoder or transport stalls.

config APP_RTC_H264_KEY_FRAME_REQUEST_MIN_INTERVAL_MS
    int "Minimum interval between local H264 key-frame requests"
    range 0 5000
    default 2000
    help
        Coalesce repeated peer-side IDR requests against the most recently
        accepted request.
        The normal 40-frame GOP at 20fps already emits an IDR every two
        seconds. Reconfiguring the hardware encoder more often can reset GOP
        progress and stall the bidirectional media path. Stream start still
        explicitly requests the first key frame.

config APP_RTC_TRANSPORT_BACKPRESSURE_HOLD_MS
    int "RTC transport backpressure hold in milliseconds"
    range 40 1000
    default 80
    help
        One-frame camera pacing window after the TiRTC send buffer crosses the
        transport guard waterline. Sustained congestion is handled separately
        by the hysteretic video governor. This guard does not change the active
        video profile; it only leaves room for heartbeat/control traffic.

config APP_TIRTC_QUERY_SEND_BUFFER_USED
    bool "Query TiRTC SDK send-buffer usage"
    default y
    help
        Keep SDK send-buffer backpressure enabled on the send hot path.
        Close/error snapshots still use the cached waterline only, because
        some SDK builds can invalidate a connection handle during remote close.
        Disable this only when isolating SDK send-buffer internals.

endmenu

menu "Debug utilities"

config APP_VERBOSE_RUNTIME_LOGS
    bool "Enable verbose runtime flow logs"
    default n
    help
        Restore detailed HTTP, MQTT, ESP-Hosted, media handoff, and call-state
        tracing for a focused diagnosis. Normal builds keep lifecycle, first
        frame, warning, and error logs while suppressing repetitive internals.

config APP_MEDIA_PERIODIC_DIAGNOSTICS
    bool "Enable periodic media performance diagnostics"
    default n
    help
        Print long camera, RTC transmit, decoder, audio-level, and whole-system
        snapshots while media is running. These lines are useful for a focused
        profiling session, but synchronous console output can pause realtime
        media tasks and create visible periodic video stalls. Keep this off for
        normal calls and enable it only while collecting performance evidence.

config APP_MEDIA_COMPACT_HEALTH_LOG
    bool "Enable one compact media health line"
    default n
    help
        Print one short MEDIA line every five seconds while an RTC media
        session is active. It reports camera and transmitted frame rates,
        queue pressure, failures, and whether AEC is active and receiving a
        playback reference. Keep this off for normal operation and enable it
        only while collecting media performance evidence.

config APP_DEBUG_SCREEN_SERVER_ENABLE
    bool "Enable LAN screen debug web server"
    default n
    help
        Starts a local HTTP server after the display is initialized.
        The server exposes the current LVGL screen as BMP and accepts
        debug tap/scroll commands from a browser on the same Wi-Fi LAN.
        Disable this for production builds to avoid compiling or linking
        the HTTP debug server.

config APP_DEBUG_SCREEN_SERVER_PORT
    int "LAN screen debug web server port"
    range 1024 65534
    default 8080
    depends on APP_DEBUG_SCREEN_SERVER_ENABLE

endmenu
```
