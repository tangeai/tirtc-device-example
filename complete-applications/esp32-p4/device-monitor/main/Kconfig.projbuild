## complete-applications/esp32-s3/device-monitor/main/Kconfig.projbuild
```kconfig
menu "Audio"

config AUDIO_LOCAL_LOOPBACK_TEST
    bool "Enable temporary local mic-to-speaker loopback test"
    default n

endmenu

menu "Debug utilities"

config APP_SERIAL_NET_CLI_ENABLE
    bool "Enable UART network diagnostics command set"
    default y
    help
        Adds a fixed-buffer AT command parser on the configured console UART.
        It exposes Wi-Fi association, DHCP, DNS, time, service discovery and
        binding/online readiness without printing passwords, tokens or keys.
        Disable this option for production builds that do not need field
        network diagnostics.

config APP_DEBUG_SCREEN_SERVER_ENABLE
    bool "Enable LAN screen debug web server"
    default n
    help
        Starts a local HTTP server after the display is initialized.
        The server exposes the current LVGL screen as BMP and accepts
        debug tap/scroll commands from a browser on the same Wi-Fi LAN.
        Disable this for production builds to avoid compiling or linking
        the HTTP debug server.

config APP_DEBUG_SCREEN_SERVER_PORT
    int "LAN screen debug web server port"
    range 1024 65534
    default 8080
    depends on APP_DEBUG_SCREEN_SERVER_ENABLE

endmenu
```

## complete-applications/g32s10x/device-monitor/integration/package/application/Config.in
```kconfig
menu "Application"

config CONFIG_APPLICATION
    bool

source package/application/app_launcher/Config.in
source package/application/load_kernel/Config.in
source package/application/app_home/Config.in
source package/application/infrared_face/Config.in
source package/application/app_ivs_face/Config.in
source package/application/app_multi_obj/Config.in
source package/application/app_scancode/Config.in
source package/application/app_audio/Config.in
source package/application/app_tirtc_demo/Config.in
source package/application/app_setting/Config.in
source package/application/app_status_bar/Config.in
source package/application/com_services/Config.in
source package/application/app_motor/Config.in
source package/application/app_aliyun/Config.in
source package/application/app_micropython/Config.in

endmenu
```

## complete-applications/g32s10x/device-monitor/integration/package/application/app_tirtc_demo/Config.in
```kconfig
menuconfig CONFIG_APPLICATION_TIRTC_DEMO
    bool "TiRTC demo application"
    depends on CONFIG_LVGL
    select CONFIG_APPLICATION
    select CONFIG_APPLICATION_LAUNCHER
    select CONFIG_APPLICATION_HOME
    select CONFIG_APPLICATION_STATUS_BAR
    default n

config CONFIG_APPLICATION_TIRTC_SCREEN_DEBUG
    bool "TiRTC browser screen debug server"
    default n
    help
      Exposes the current LVGL screen as BMP over HTTP port 8080.

endmenu # CONFIG_APPLICATION_TIRTC_DEMO
```

## complete-applications/g32s10x/device-monitor/integration/package/third_party/Config.in
```kconfig
menu "第三方软件列表"
source package/third_party/libstdc++/Config.in
source package/third_party/libcxx/Config.in
source package/third_party/libmad/Config.in
source package/third_party/libsamplerate/Config.in
source package/third_party/af_resample/Config.in
source package/third_party/awtk/Config.in
source package/third_party/memtester/Config.in
source package/third_party/libjpeg/Config.in
source package/third_party/jpeg-turbo/Config.in
source package/third_party/jpeg-tiny/Config.in
source package/third_party/libfacedet/Config.in
source package/third_party/libiaac/Config.in
source package/third_party/libgoodixTof/Config.in
source package/third_party/zlib/Config.in
source package/third_party/lrzsz/Config.in
source package/third_party/lvgl/Config.in
source package/third_party/lzma/Config.in
source package/third_party/voxa/Config.in
source package/third_party/notch_filter/Config.in
source package/third_party/cjson/Config.in
source package/third_party/alg_ivs/Config.in
source package/third_party/tc_iot/Config.in
source package/third_party/opus/Config.in
source package/third_party/mbedtls/Config.in
source package/third_party/tirtc/Config.in
source package/third_party/aliyun_sdk/Config.in
source package/third_party/micropython/Config.in
endmenu
```

## complete-applications/g32s10x/device-monitor/integration/package/third_party/tirtc/Config.in
```kconfig
config CONFIG_TIRTC
    bool "TiRTC SDK"
    depends on CONFIG_RISCV1
    select CONFIG_MBEDTLS
    default n
    help
        Enable the TiRTC SDK for Ingenic G32S10X FreeRTOS.
```
